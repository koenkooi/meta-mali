## conf/layer.conf
```bitbake
# We have a conf and classes directory, add to BBPATH
BBPATH .= ":${LAYERDIR}"

# We have recipes-* directories, add to BBFILES
BBFILES += "${LAYERDIR}/recipes-*/*/*.bb \
            ${LAYERDIR}/recipes-*/*/*.bbappend"

BBFILE_COLLECTIONS += "mali"
BBFILE_PATTERN_mali = "^${LAYERDIR}/"
BBFILE_PRIORITY_mali = "5"
LAYERVERSION_mali = "0"
```

## conf/machine/odroidxu3.conf
```bitbake
#@TYPE: Machine
#@NAME: odroidxu3

#@DESCRIPTION: Machine configuration for HardKernel ODROID-XU3

include conf/machine/include/tune-cortexa15.inc
DEFAULTTUNE = "cortexa15hf-neon"

IMAGE_FSTYPES += "tar.bz2 ext3"

PREFERRED_PROVIDER_virtual/kernel ?= "linux-odroidxu3"

UBOOT_SUFFIX = "bin"
UBOOT_MACHINE = "odroid_config"

KERNEL_IMAGETYPE = "zImage"
KERNEL_DEVICETREE = "exynos5422-odroidxu3.dtb"
```
